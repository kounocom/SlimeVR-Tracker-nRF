## prj.conf
```kconfig
#CONFIG_NCS_SAMPLES_DEFAULTS
CONFIG_ASSERT=y
CONFIG_ASSERT_NO_COND_INFO=y
CONFIG_ASSERT_NO_MSG_INFO=y
CONFIG_RESET_ON_FATAL_ERROR=y

CONFIG_NCS_APPLICATION_BOOT_BANNER_STRING="SlimeVR-Tracker-nRF"
#CONFIG_NCS_BOOT_BANNER=n
CONFIG_BOOT_BANNER=n

CONFIG_ESB=y
#need to enable for nRF54L
#CONFIG_NRFX_DPPI10=y

CONFIG_ADC=y
CONFIG_ADC_NRFX_SAADC=y
CONFIG_FPU=y
CONFIG_I2C=y
CONFIG_SPI=y
CONFIG_PINCTRL=y

CONFIG_NVS=y
CONFIG_NVS_LOOKUP_CACHE=y
CONFIG_NVS_INIT_BAD_MEMORY_REGION=y

CONFIG_POWEROFF=y
CONFIG_REBOOT=y

CONFIG_FLASH=y
CONFIG_FLASH_PAGE_LAYOUT=y
CONFIG_FLASH_MAP=y

CONFIG_SETTINGS=y
CONFIG_SETTINGS_RUNTIME=y
CONFIG_SETTINGS_NONE=y

CONFIG_MPU_ALLOW_FLASH_WRITE=y

CONFIG_RETAINED_MEM=y

CONFIG_USE_SEGGER_RTT=y
CONFIG_LOG=y
#CONFIG_PRINTK=y
CONFIG_LOG_MODE_DEFERRED=y
CONFIG_LOG_SPEED=y
CONFIG_LOG_BACKEND_RTT=y
CONFIG_CBPRINTF_FP_SUPPORT=y
CONFIG_ADC_LOG_LEVEL_OFF=y
CONFIG_LOG_FUNC_NAME_PREFIX_ERR=y
CONFIG_LOG_BUFFER_SIZE=1536
CONFIG_LOG_BACKEND_UART_AUTOSTART=n
CONFIG_LOG_PROCESS_THREAD_SLEEP_MS=50
CONFIG_LOG_PROCESS_THREAD_STACK_SIZE=1024

CONFIG_PWM=y
CONFIG_GPIO=y

CONFIG_CRC=y

CONFIG_NEWLIB_LIBC=y
#deprecated?
#CONFIG_NRFX_TIMER1=y

# Use uncalibrated RC clock on boot, will switch to external oscillator in the app after boot
CONFIG_CLOCK_CONTROL_NRF_K32SRC_RC=y
CONFIG_CLOCK_CONTROL_NRF_K32SRC_RC_CALIBRATION=n
CONFIG_CLOCK_CONTROL_NRF_K32SRC_SYNTH=n

# dont need it
CONFIG_CRYPTO=n

# set timeout for 25ms, sufficient for ~1000 bytes
CONFIG_I2C_NRFX_TRANSFER_TIMEOUT=25

CONFIG_USB_DEVICE_HID=y
CONFIG_USB_DEVICE_VID=0x1209
CONFIG_USB_DEVICE_PID=0x7692
CONFIG_USB_HID_BOOT_PROTOCOL=y
CONFIG_USB_DEVICE_INITIALIZE_AT_BOOT=n
CONFIG_USB_CDC_ACM=y
CONFIG_UART_INTERRUPT_DRIVEN=y
CONFIG_USB_WORKQUEUE_STACK_SIZE=512

CONFIG_SERIAL=y
CONFIG_CONSOLE=y
CONFIG_RTT_CONSOLE=y
CONFIG_UART_CONSOLE=y
CONFIG_UART_LINE_CTRL=y
# fit "write all <base64:173>"
CONFIG_CONSOLE_INPUT_MAX_LINE_LEN=256

CONFIG_LOG=y
CONFIG_USB_DRIVER_LOG_LEVEL_ERR=y
CONFIG_USB_DEVICE_LOG_LEVEL_ERR=y
CONFIG_USB_CDC_ACM_LOG_LEVEL_OFF=y

CONFIG_LOG_BACKEND_UART=y

CONFIG_CONSOLE_SUBSYS=y
CONFIG_CONSOLE_GETLINE=y

CONFIG_NVS_LOG_LEVEL_WRN=y
CONFIG_USB_HID_LOG_LEVEL_WRN=y

CONFIG_USB_DEVICE_SOF=y
CONFIG_USB_HID_REPORTS=256

#CONFIG_USB_HID_POLL_INTERVAL_MS=1
CONFIG_USB_HID_POLL_INTERVAL_MS=0
CONFIG_HID_INTERRUPT_EP_MPS=64
#CONFIG_ENABLE_HID_INT_OUT_EP=y

CONFIG_SYSTEM_WORKQUEUE_STACK_SIZE=256
CONFIG_MAIN_STACK_SIZE=512
#crashing on nrf54l at 512

CONFIG_THREAD_NAME=y

# TODO: because of icm426, this will break things and needs to be raised to at least 3k
CONFIG_HEAP_MEM_POOL_SIZE=2048
CONFIG_ISR_STACK_SIZE=1024

CONFIG_PM_DEVICE=y

CONFIG_BASE64=y

#CONFIG_THREAD_ANALYZER=y
#CONFIG_THREAD_ANALYZER_AUTO=y
#CONFIG_THREAD_ANALYZER_AUTO_INTERVAL=5

CONFIG_USE_IMU_TIMEOUT=n
```

## src/main.c
```c
/*
	SlimeVR Code is placed under the MIT license
	Copyright (c) 2025 SlimeVR Contributors

	Permission is hereby granted, free of charge, to any person obtaining a copy
	of this software and associated documentation files (the "Software"), to deal
	in the Software without restriction, including without limitation the rights
	to use, copy, modify, merge, publish, distribute, sublicense, and/or sell
	copies of the Software, and to permit persons to whom the Software is
	furnished to do so, subject to the following conditions:

	The above copyright notice and this permission notice shall be included in
	all copies or substantial portions of the Software.

	THE SOFTWARE IS PROVIDED "AS IS", WITHOUT WARRANTY OF ANY KIND, EXPRESS OR
	IMPLIED, INCLUDING BUT NOT LIMITED TO THE WARRANTIES OF MERCHANTABILITY,
	FITNESS FOR A PARTICULAR PURPOSE AND NONINFRINGEMENT. IN NO EVENT SHALL THE
	AUTHORS OR COPYRIGHT HOLDERS BE LIABLE FOR ANY CLAIM, DAMAGES OR OTHER
	LIABILITY, WHETHER IN AN ACTION OF CONTRACT, TORT OR OTHERWISE, ARISING FROM,
	OUT OF OR IN CONNECTION WITH THE SOFTWARE OR THE USE OR OTHER DEALINGS IN
	THE SOFTWARE.
*/
#include "globals.h"
#include "system/system.h"
//#include "timer.h"
#include "connection/esb.h"
#include "sensor/sensor.h"

#include <zephyr/sys/reboot.h>

#define DFU_DBL_RESET_MEM 0x20007F7C
#define DFU_DBL_RESET_APP 0x4ee5677e

static uint32_t *dbl_reset_mem __attribute__((unused)) = ((uint32_t *)DFU_DBL_RESET_MEM); // retained

LOG_MODULE_REGISTER(main, LOG_LEVEL_INF);

#if DT_NODE_HAS_PROP(DT_ALIAS(sw0), gpios)
#define BUTTON_EXISTS true
#endif

#define DFU_EXISTS CONFIG_BUILD_OUTPUT_UF2 || CONFIG_BOARD_HAS_NRF5_BOOTLOADER
#define ADAFRUIT_BOOTLOADER CONFIG_BUILD_OUTPUT_UF2

int main(void)
{
#ifdef NRF_RESET
	bool reset_pin_reset = NRF_RESET->RESETREAS & RESET_RESETREAS_RESETPIN_Msk;
	NRF_RESET->RESETREAS = NRF_RESET->RESETREAS; // Clear RESETREAS
#else
	bool reset_pin_reset = NRF_POWER->RESETREAS & POWER_RESETREAS_RESETPIN_Msk;
	NRF_POWER->RESETREAS = NRF_POWER->RESETREAS; // Clear RESETREAS
#endif

#if BUTTON_EXISTS
	if (CONFIG_0_SETTINGS_READ(CONFIG_0_IGNORE_RESET))
		reset_pin_reset = false;
#endif

	set_led(SYS_LED_PATTERN_ONESHOT_WAKE, SYS_LED_PRIORITY_BOOT); // Boot LED

	uint8_t reboot_counter = reboot_counter_read();
	bool booting_from_shutdown = !reboot_counter && (reset_pin_reset || button_read()); // 0 means from user shutdown or failed ram validation

	/* if button is not held after booting from shutdown, power off again
	 * if button press is normal, continue boot
	 * if button is held for 1 second, reset pairing and continue boot
	 */

	if (button_read())
	{
		while (button_read())
		{
			if (k_uptime_get() > 1000)
			{
				LOG_INF("Pairing requested");
				esb_reset_pair();
				break;
			}
			k_msleep(1);
		}
		if (CONFIG_0_SETTINGS_READ(CONFIG_0_USER_SHUTDOWN) && k_uptime_get() < 50 && booting_from_shutdown) // debounce
			sys_request_system_off(false);
		if (k_uptime_get() <= 1000)
			set_led(SYS_LED_PATTERN_ONESHOT_POWERON, SYS_LED_PRIORITY_BOOT);
	}
	else if (booting_from_shutdown)
		set_led(SYS_LED_PATTERN_ONESHOT_POWERON, SYS_LED_PRIORITY_BOOT);

	bool docked = dock_read();

	uint8_t reset_mode = -1;

	if (reboot_counter == 0)
		reboot_counter = 100;
	else if (reboot_counter > 200)
		reboot_counter = 200; // How did you get here
	reset_mode = reboot_counter - 100;
	if (reset_pin_reset && !docked) // Count pin resets while not docked
	{
		reboot_counter++;
		reboot_counter_write(reboot_counter);
		LOG_INF("Reset count: %u", reboot_counter);
#if ADAFRUIT_BOOTLOADER
#if BUTTON_EXISTS
		if (!CONFIG_0_SETTINGS_READ(CONFIG_0_IGNORE_RESET))
			(*dbl_reset_mem) = DFU_DBL_RESET_APP; // Using Adafruit bootloader, skip DFU if reset button could be used
#else
		(*dbl_reset_mem) = DFU_DBL_RESET_APP; // Using Adafruit bootloader, skip DFU since reset button is used
#endif
#endif
		k_msleep(1000); // Wait before clearing counter and continuing
	}
	reboot_counter_write(100);
	if (!reset_pin_reset && reset_mode == 0) // Only need to check once, if the button is pressed again an interrupt is triggered from before
		reset_mode = -1; // Cancel reset_mode (shutdown)

	if (CONFIG_0_SETTINGS_READ(CONFIG_0_USER_SHUTDOWN))
	{
		bool charging = chg_read();
		bool charged = stby_read();
		bool plugged = vin_read();

		if (reset_mode == 0 && !booting_from_shutdown && !charging && !charged && !plugged) // Reset mode user shutdown, only if unplugged and undocked
			sys_user_shutdown();
	}

	sys_reset_mode(reset_mode);

	return 0;
}
```
